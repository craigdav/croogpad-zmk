## config/west.yml
```yaml
manifest:
  remotes:
    - name: craigdav
      url-base: https://github.com/craigdav
  projects:
    - name: croogpad-zmk
      remote: craigdav
      revision: main
      import: app/west.yml
  self:
    path: config
```
